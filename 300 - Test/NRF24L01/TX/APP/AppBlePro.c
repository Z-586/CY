#include "includes.h"

static uint8_t rx_status = 0;
static uint8_t rx_buf[10];
static uint8_t tx_buf[10];
static uint32_t count_time = 0;
static uint8_t Stop_state = 0;
static uint16_t count_delay_time = 0;
extern unsigned char INIT_ADDR[5]; //节点地址
//static const unsigned char Iint_ADDR[5]= {0x00,0x1A,0xB1,0xB1,0x01}; // //默认节点地址

uint8_t tx_status = 0;
uint8_t tx_time_status = 0;

static TimerHandle_t m_parse_date_timer;        	/**< Definition of battery timer. */
float Rx_Temp = 0;
uint16_t CRC_Value = 0;

static uint8_t STM32_ID[12] ={0};
uint8_t TX_RX_status = 0;
static uint8_t pwm_start_flag = 0;
static const unsigned char Iint_ADDR[5]= {0x00,0x1A,0xB1,0xB1,0x01}; // //默认节点地址
void EfficiencyCalculation(void);
void Adc_deal(void);

void Reset_Variable(void)
{
	RXparameter.RX_I = 0;
	RXparameter.RX_Uout = 0;
	RXparameter.RX_Uin = 0;
	RXparameter.RX_T1 = 0;
	TXparameter.efficiency = 0;
	
	TXparameter.system_stat1 = 0;
//	GPIO_ResetBits(GPIOC, SWITCH_IO); 
}


/**@brief Function for handling the Battery measurement timer time-out.
 *
 * @details This function will be called each time the battery level measurement timer expires.
 *
 * @param[in] xTimer Handler to the timer that called this function.
 *                   You may get identifier given to the function xTimerCreate using pvTimerGetTimerID.
 */
static const uint8_t aucCRCHi[] = {
    0x00, 0xC1, 0x81, 0x40, 0x01, 0xC0, 0x80, 0x41, 0x01, 0xC0, 0x80, 0x41,
    0x00, 0xC1, 0x81, 0x40, 0x01, 0xC0, 0x80, 0x41, 0x00, 0xC1, 0x81, 0x40,
    0x00, 0xC1, 0x81, 0x40, 0x01, 0xC0, 0x80, 0x41, 0x01, 0xC0, 0x80, 0x41,
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    0x00, 0xC1, 0x81, 0x40
};


static const uint8_t aucCRCLo[] = {
    0x00, 0xC0, 0xC1, 0x01, 0xC3, 0x03, 0x02, 0xC2, 0xC6, 0x06, 0x07, 0xC7,
    0x05, 0xC5, 0xC4, 0x04, 0xCC, 0x0C, 0x0D, 0xCD, 0x0F, 0xCF, 0xCE, 0x0E,
    0x0A, 0xCA, 0xCB, 0x0B, 0xC9, 0x09, 0x08, 0xC8, 0xD8, 0x18, 0x19, 0xD9,
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    0x41, 0x81, 0x80, 0x40
};

uint16_t usCRC16( uint8_t * pucFrame, uint16_t usLen )
{
    uint8_t         ucCRCHi = 0xFF;
    uint8_t         ucCRCLo = 0xFF;
    int             iIndex;

    while( usLen-- )
    {
        iIndex = ucCRCLo ^ *( pucFrame++ );
        ucCRCLo = ( uint8_t )( ucCRCHi ^ aucCRCHi[iIndex] );
        ucCRCHi = aucCRCLo[iIndex];
    }
    return ( uint16_t )( ucCRCHi << 8 | ucCRCLo );
}


static void parse_date_handler(TimerHandle_t xTimer)
{
	if(TX_RX_status == 1){
		CRC_Value = usCRC16(rx_buf,8);
		if(CRC_Value == ((((uint16_t)rx_buf[8])<<8)|rx_buf[9])) {
			RXparameter.RX_Uout = ((((uint16_t)rx_buf[4])<<8)|rx_buf[5]);
			RXparameter.RX_I = ((((uint16_t)rx_buf[6])<<8)|rx_buf[7]);
			RXparameter.RX_T1  = (((uint16_t)rx_buf[2])<<8)|rx_buf[3];
		}
		Debug_Printf("%d,%d\r\nR_T:%d °C, R_V:%dV, R_I:%dA, TXparameter.system_stat2:%d\r\n",\
		TX_RX_status,PwmFreq, RXparameter.RX_T1, RXparameter.RX_Uout, RXparameter.RX_I, TXparameter.system_stat2);
	}
}

uint32_t NRF_ID(const uint8_t *data, uint8_t length) {
    uint32_t hash = 0;
    for (uint8_t i = 0; i < length; i++) {
        hash = (hash << 4) + data[i];
        uint32_t g = hash & 0xF0000000;
        if (g != 0) {
            hash ^= g >> 24;
            hash ^= g;
        }
    }
    return hash;
}


void Get_CPU_ID(void){
	//获取CPU唯一ID
	uint32_t chipId[4] = {0};		
	chipId[0] =*(volatile unsigned long *)(0x1fff7590); //按全字（32位）读取
	chipId[1] =*(volatile unsigned long *)(0x1fff7594);
	chipId[2] =*(volatile unsigned long *)(0x1fff7598);
	
	STM32_ID[0] = (uint8_t)(chipId[0] & 0x000000FF);
	STM32_ID[1] = (uint8_t)((chipId[0] & 0xFF00) >>8);
	STM32_ID[2] = (uint8_t)((chipId[0] & 0xFF0000) >>16);
	STM32_ID[3] = (uint8_t)((chipId[0] & 0xFF000000) >>24);
	
	STM32_ID[4] = (uint8_t)(chipId[1] & 0xFF);
	STM32_ID[5] = (uint8_t)((chipId[1] & 0xFF00) >>8);
	STM32_ID[6] = (uint8_t)((chipId[1] & 0xFF0000) >>16);
	STM32_ID[7] = (uint8_t)((chipId[1] & 0xFF000000) >>24);
	
	STM32_ID[8] = (uint8_t)(chipId[2] & 0xFF);
	STM32_ID[9] = (uint8_t)((chipId[2] & 0xFF00) >>8);
	STM32_ID[10] = (uint8_t)((chipId[2] & 0xFF0000) >>16);
	STM32_ID[11] = (uint8_t)((chipId[2] & 0xFF000000) >>24);
	chipId[3] = NRF_ID(STM32_ID,12);
	
	INIT_ADDR[1] = (uint8_t)(chipId[3] & 0x000000FF);
	INIT_ADDR[2] = (uint8_t)((chipId[3] & 0xFF00) >>8);
	INIT_ADDR[3] = (uint8_t)((chipId[3] & 0xFF0000) >>16);
	INIT_ADDR[4] = (uint8_t)((chipId[3] & 0xFF000000) >>24);
	memcpy(tx_buf,INIT_ADDR,5);
	tx_buf[8] = usCRC16(tx_buf,8)>>8;
	tx_buf[9] = usCRC16(tx_buf,8);
}


void BlePro_task(void *pvParameters)
{	

	PwmFreq = SET_PWM_Freq(85000);
	Start_PWM();
	for (int i = 1; i < 46; i++) {
		hhrtim1.Instance->sTimerxRegs[0].PERxR = PwmFreq;
		hhrtim1.Instance->sTimerxRegs[0].CMP1xR = (PwmFreq * (100 - i)) / 100;
		hhrtim1.Instance->sTimerxRegs[0].CMP3xR = (PwmFreq * i) / 100;
		vTaskDelay(20);
	}
	while(1){
		vTaskDelay(2000);
	}
}  

